## build/Kconfig/arch/Kconfig
```kconfig
# Load Zephyr Arch Kconfig descriptions.
osource "/home/kavin/zephyrproject/zephyr/arch/x86/Kconfig"
osource "/home/kavin/zephyrproject/zephyr/arch/xtensa/Kconfig"
osource "/home/kavin/zephyrproject/zephyr/arch/sparc/Kconfig"
osource "/home/kavin/zephyrproject/zephyr/arch/riscv/Kconfig"
osource "/home/kavin/zephyrproject/zephyr/arch/posix/Kconfig"
osource "/home/kavin/zephyrproject/zephyr/arch/nios2/Kconfig"
osource "/home/kavin/zephyrproject/zephyr/arch/mips/Kconfig"
osource "/home/kavin/zephyrproject/zephyr/arch/arm64/Kconfig"
osource "/home/kavin/zephyrproject/zephyr/arch/arm/Kconfig"
osource "/home/kavin/zephyrproject/zephyr/arch/arc/Kconfig"
```

## build/Kconfig/boards/Kconfig.defconfig
```kconfig
# Load Zephyr board defconfig descriptions.
osource "/home/kavin/zephyrproject/zephyr/boards/silabs/radio_boards/xg24_ek2703atest/Kconfig.defconfig"
```

## build/Kconfig/boards/Kconfig.sysbuild
```kconfig
# Load Sysbuild board Kconfig descriptions.
osource "/home/kavin/zephyrproject/zephyr/boards/silabs/radio_boards/xg24_ek2703atest/Kconfig.sysbuild"
```
